
  SET_REGISTER(PA_TABLE0, 0xFE)
  SET_REGISTER(FREQ2, 0x64)
  SET_REGISTER(FREQ1, 0x25)
  SET_REGISTER(FREQ0, 0x00)
  SET_REGISTER(MDMCFG1, 0x43)
  SET_REGISTER(MDMCFG0, 0x87)
  SET_REGISTER(FSCTRL1, 0x0A)
  SET_REGISTER(FSCTRL0, 0x00)
  SET_REGISTER(MDMCFG4, 0x1D)
  SET_REGISTER(MDMCFG3, 0xDE)
  SET_REGISTER(MDMCFG2, 0x73)
  SET_REGISTER(FREND1, 0xB6)
  SET_REGISTER(FREND0, 0x10)
  SET_REGISTER(FOCCFG, 0x1D)
  SET_REGISTER(BSCFG, 0x1C)
  SET_REGISTER(AGCCTRL2, 0xC7)
  SET_REGISTER(AGCCTRL1, 0x00)
  SET_REGISTER(AGCCTRL0, 0xB2)
  SET_REGISTER(FSCAL3, 0xEA)
  SET_REGISTER(FSCAL2, 0x0A)
  SET_REGISTER(FSCAL1, 0x00)
  SET_REGISTER(FSCAL0, 0x11)
  SET_REGISTER(TEST2, 0x88)
  SET_REGISTER(TEST1, 0x31)
  SET_REGISTER(TEST0, 0x09)
  SET_REGISTER(PKTCTRL1, 0x04)
  SET_REGISTER(PKTCTRL0, 0x45)

